## main/Kconfig.projbuild
```kconfig
menu "Example Configuration"

    visible if CUSTOM_COMMISSIONABLE_DATA_PROVIDER

    config DYNAMIC_PASSCODE_COMMISSIONABLE_DATA_PROVIDER
        bool "Enable Dynamic Passcode Commissionable Data Provider"
        depends on CUSTOM_COMMISSIONABLE_DATA_PROVIDER
        default y

    config DYNAMIC_PASSCODE_PROVIDER_DISCRIMINATOR
        int "Discriminator in Dynamic Passcode Commissionable Data Provider"
        depends on DYNAMIC_PASSCODE_COMMISSIONABLE_DATA_PROVIDER
        default 3840
        range 0 4095
        help
            Fixed discriminator in custom dynamic passcode commissionable data provider

    config DYNAMIC_PASSCODE_PROVIDER_ITERATIONS
        int "Iterations in Dynamic Passcode Commissionable Data Provider"
        depends on DYNAMIC_PASSCODE_COMMISSIONABLE_DATA_PROVIDER
        default 10000
        range 1000 100000
        help
            Fixed iterations in custom dynamic passcode commissionable data provider

    config DYNAMIC_PASSCODE_PROVIDER_SALT_BASE64
        string "Base64-Encoded Salt in Dynamic Passcode Commissionable Data Provider"
        depends on DYNAMIC_PASSCODE_COMMISSIONABLE_DATA_PROVIDER
        default "0NHS09TV1tfY2drb3N3e36ChoqOkpaanqKmqq6ytrq8="
        help
            Fixed salt in custom dynamic passcode commissionable data provider. It should be a Base64-Encoded string.

endmenu

menu "Air Conditioner Configuration"

    config AC_ENABLE_AUTO
        bool "Enable Auto mode"
        default y
        help
            Adds the AutoMode feature (Off/Heat/Cool/Auto) to the Thermostat cluster. Heat and Cool are
            always there (a Room Air Conditioner always has the Cooling feature).

    config AC_MIN_SETPOINT
        int "Lowest setpoint (degC)"
        default 16
        range 5 30
        help
            Lowest temperature which can be set in the controllers (Apple Home, Home Assistant).

    config AC_MAX_SETPOINT
        int "Highest setpoint (degC)"
        default 30
        range 10 35
        help
            Highest temperature which can be set in the controllers.

    config AC_DEAD_BAND
        int "Auto dead band (0.1 degC)"
        depends on AC_ENABLE_AUTO
        default 0
        range 0 50
        help
            Minimum distance between the heating and the cooling setpoint (MinSetpointDeadBand), 10 = 1.0 degC.
            The heating range ends this much below the highest setpoint and the cooling range starts this much
            above the lowest one, otherwise the Thermostat server would reject a heating setpoint near the
            maximum even in Heat mode. Apple Home offers one range for all modes, so with a dead band the
            highest values of the heating slider are rejected and the slider jumps back.
            With 0 both setpoints use the full range.

    config AC_TRACE_LOGS
        bool "Trace attribute writes (debug)"
        default n
        help
            Temporary debug logs with the "[TRACE]" prefix: every PRE_UPDATE/POST_UPDATE of a Thermostat
            attribute and every attribute::update() of the application, with the value and the reason.
            The chip[EM] line just before a POST_UPDATE shows which controller (fabric:node) wrote it.

    config AC_STATUS_LED_GPIO
        int "WS2812 status LED GPIO"
        default 8
        range -1 ENV_GPIO_OUT_RANGE_MAX
        help
            Data GPIO of the addressable WS2812 LED (GPIO 8 on ESP32-C6-DevKitC/M). Set -1 to disable.
            Orange: Heat, Blue: Cool, Green: Auto, Cyan: FanOnly/Dry, White: off.

    config AC_TEMPERATURE_STEP
        int "Temperature rounding step (0.01 degC)"
        default 50
        range 1 100
        help
            The temperature from the sensor is rounded to the nearest multiple of this step before it is
            shown as LocalTemperature. Default 50 means 0.5 degC
            (24.20 -> 24.0, 24.30 -> 24.5). 1 keeps the value exactly as the sensor reports it.

    config AC_TEMPERATURE_CALIBRATION
        int "Temperature calibration (0.1 degC)"
        default 0
        range -25 25
        help
            Initial LocalTemperatureCalibration: added to the sensor temperature before the rounding.
            For example -5 means -0.5 degC. Used on the very first boot (or after a factory reset) only,
            afterwards the value written by a controller is restored from NVS.

    config AC_SENSOR_MIN_INTERVAL
        int "Sensor subscription min interval (seconds)"
        default 5
        range 0 60

    config AC_SENSOR_MAX_INTERVAL
        int "Sensor subscription max interval (seconds)"
        default 60
        range 10 3600
        help
            Requested max reporting interval of the subscription to the remote sensor. The sensor
            sends a report at least this often, even when the value does not change.

    config AC_SENSOR_TIMEOUT
        int "Sensor timeout (seconds)"
        default 300
        range 30 86400
        help
            If no report is received from the temperature sensor for this time, the reading is
            treated as unknown (LocalTemperature null). Must be larger than the max interval.

endmenu

menu "Air Conditioner Device Information"

    config AC_VENDOR_NAME
        string "Vendor name"
        default "DIY"
        help
            Shown as Manufacturer in the controllers (BasicInformation VendorName).

    config AC_PRODUCT_NAME
        string "Product name"
        default "Air Conditioner"
        help
            Shown as Model in the controllers (BasicInformation ProductName and ProductLabel).

    config AC_HARDWARE_VERSION_STRING
        string "Hardware version"
        default "ESP32-C6"
        help
            The board. The protocol and the model of the IR remote are added, e.g. "ESP32-C6, FUJITSU_AC ARRAH2E"
            (Hardware in Apple Home and Home Assistant).

    config AC_SERIAL_NUMBER_PREFIX
        string "Serial number prefix"
        default "ACIR-"
        help
            The serial number is this prefix followed by the MAC address of the chip, unique for every board.

endmenu
```
